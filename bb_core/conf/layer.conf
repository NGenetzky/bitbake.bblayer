## bb_core/conf/layer.conf
```bitbake
BBPATH .= ":${LAYERDIR}"

LAYERSERIES_CORENAMES = "56c887ac-ad31-11ea-a360-35b3ae701db0"
```

## examples/bitbake-core-fetch/conf/bblayers.conf
```bitbake
BBPATH := "${TOPDIR}"
BBFILES ?= ""
BBLAYERS = "\
${TOPDIR}/layers/bb_core/ \
${TOPDIR}/layers/bb_fetch/ \
${TOPDIR}/layers/example/ \
"
```

## examples/bitbake-core-fetch/layers/example/conf/layer.conf
```bitbake
# We have recipes-* directories, add to BBFILES
BBFILES += " \
${LAYERDIR}/recipes-*/*.bb \
"

BBFILE_COLLECTIONS += "example"
BBFILE_PATTERN_example = "^${LAYERDIR}/"
BBFILE_PRIORITY_example = "10"

# LAYERDEPENDS_example = ""
# LAYERRECOMMENDS_example = ""
# LAYERVERSION_example = "0"
LAYERSERIES_COMPAT_example = "56c887ac-ad31-11ea-a360-35b3ae701db0"
```
